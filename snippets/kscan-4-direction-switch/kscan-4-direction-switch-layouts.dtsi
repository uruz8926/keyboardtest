    /delete-node/ position_map_1;
};

&physical_layout_s {
    status = "disabled";
};

&physical_layout_m {
    status = "disabled";
};

&physical_layout_l {
    status = "disabled";
};

&physical_layout_s_4_direction {
    status = "disabled";
};

&physical_layout_m_4_direction {
    status = "disabled";
};
